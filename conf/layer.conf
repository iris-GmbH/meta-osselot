## conf/layer.conf
```bitbake
# We have a conf and classes directory, add to BBPATH
BBPATH .= ":${LAYERDIR}"
# We have recipes-* directories, add to BBFILES
BBFILES += "${LAYERDIR}/recipes-*/*/*.bb \
    ${LAYERDIR}/recipes-*/*/*.bbappend"

# Activates content when identified layers are present.
BBFILES_DYNAMIC += " \
    core:${LAYERDIR}/bbappends/openembedded-core/meta/*/*/*.bbappend \
"

BBFILE_COLLECTIONS += "meta-osselot"
BBFILE_PATTERN_meta-osselot = "^${LAYERDIR}/"
BBFILE_PRIORITY_meta-osselot = "15"

LAYERSERIES_COMPAT_meta-osselot = "dunfell"
```
